## vm/weta-esp/weta-esp-common/Kconfig.projbuild
```kconfig
menu "Weta WiFi Configuration"

choice WETA_WIFI_MODE
    prompt "Wifi Mode?"
    default WETA_WIFI_MODE_AP
    help
		Select whether the board runs as a station or an Access Point.
    
config WETA_WIFI_MODE_AP
    bool "Access Point"
	help
		Set the board as an Access Point.
		
config WETA_WIFI_MODE_STATION
    bool "Station"
	help
		Set the board as a station.
endchoice

config WIFI_SSID
	string "WiFi Access Point ID"
	default "YourWifiSSID"
	help
		The name of your WiFi Access Point as shown in a WiFi network list.
		
config WIFI_PASSWORD
	string "WiFi Password"
	default "password"
	help
		Password to your WiFi Access Point.

endmenu
```

## vm/weta-esp32/main/Kconfig.projbuild
```kconfig
menu "Board Configuration"

choice TARGET_BOARD
    prompt "Target Board"
    default TARGET_BOARD_MYNANO32
    help
		Select a target ESP32 system.
    
config TARGET_BOARD_MYNANO32
    bool "Murray's Nano32 Prototype"
	help
		Build Weta for this target.
		
config TARGET_BOARD_CARLOS
    bool "Carlos's Tangible Programming board"
	help
		Build Weta for this target.		
endchoice
endmenu
```

## vm/weta-esp32/webserver/Kconfig.projbuild
```kconfig
menu "Webserver Configuration"

config WIFI_SSID
	string "WiFi Access Point ID"
	default "YourWifiSSID"
	help
		The name of your WiFi Access Point as shown in a WiFi network list.
		
config WIFI_PASSWORD
	string "WiFi Password"
	default "password"
	help
		Password to your WiFi Access Point.

endmenu
```
